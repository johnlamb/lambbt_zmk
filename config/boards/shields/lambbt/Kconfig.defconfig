## config/boards/shields/lambbt/Kconfig.defconfig
```kconfig
if SHIELD_LAMBBT_LEFT 

config ZMK_KEYBOARD_NAME
    default "LambBT"

config ZMK_SPLIT_ROLE_CENTRAL
    default y

endif

if SHIELD_LAMBBT_LEFT || SHIELD_LAMBBT_RIGHT

config ZMK_SPLIT
    default y

endif
```

## config/boards/shields/lambbt/Kconfig.shield
```kconfig
config SHIELD_LAMBBT_LEFT
	def_bool $(shields_list_contains, lambbt_left)

config SHIELD_LAMBBT_RIGHT
	def_bool $(shields_list_contains, lambbt_right)
```
